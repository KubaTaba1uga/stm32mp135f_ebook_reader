## Config.in
```kconfig
config BR2_TARGET_UBOOT_RUN_POST_RSYNC_HOOK_SCRIPT
	string "Run U-boot post-rsync hook"
	default ""

source "$BR2_EXTERNAL_EBK_READER_PATH/package/stm32wrapper4dbg/Config.in.host"
source "$BR2_EXTERNAL_EBK_READER_PATH/package/it8951_epaper/Config.in"
source "$BR2_EXTERNAL_EBK_READER_PATH/package/lvgl/Config.in"
source "$BR2_EXTERNAL_EBK_READER_PATH/package/ebook_reader/Config.in"
```

## br2_external/configs/ebook_reader_dev_defconfig
```kconfig
##############################################
#                  Buildroot                 #
##############################################
BR2_arm=y
BR2_cortex_a7=y
BR2_GLOBAL_PATCH_DIR="$(BR2_EXTERNAL_ST_PATH)/board/ebook_reader/patches/"
BR2_PACKAGE_HOST_BMAP_TOOLS=y
BR2_PACKAGE_HOST_GENIMAGE=y
BR2_CCACHE=y
BR2_TARGET_GENERIC_HOSTNAME="ebook_reader"
BR2_TARGET_GENERIC_GETTY_OPTIONS="-a root"

##############################################
#                  Toolchain                 #
##############################################
BR2_TOOLCHAIN_EXTERNAL=y
BR2_TOOLCHAIN_EXTERNAL_BOOTLIN=y
BR2_TOOLCHAIN_EXTERNAL_BOOTLIN_ARMV7_EABIHF_GLIBC_STABLE=y

##############################################
#                  Rootfs                    #
##############################################
BR2_ROOTFS_DEVICE_CREATION_DYNAMIC_MDEV=y
BR2_ROOTFS_OVERLAY="$(BR2_EXTERNAL_ST_PATH)/board/ebook_reader/overlay/"
BR2_TARGET_ROOTFS_TAR=y

##############################################
#                  Linux                     #
##############################################
BR2_LINUX_KERNEL=y
BR2_LINUX_KERNEL_CUSTOM_TARBALL=y
BR2_LINUX_KERNEL_CUSTOM_TARBALL_LOCATION="$(call github,STMicroelectronics,linux)v6.6-stm32mp-r2.tar.gz"
BR2_LINUX_KERNEL_DEFCONFIG="multi_v7"
BR2_LINUX_KERNEL_CONFIG_FRAGMENT_FILES="$(LINUX_DIR)/arch/arm/configs/fragment-01-multiv7_cleanup.config $(LINUX_DIR)/arch/arm/configs/fragment-02-multiv7_addons.config $(BR2_EXTERNAL_ST_PATH)/board/stmicroelectronics/common/linux-disable-etnaviv.config $(BR2_EXTERNAL_ST_PATH)/board/stmicroelectronics/common/linux-enable-fbdev-emul.config $(BR2_EXTERNAL_ST_PATH)/board/ebook_reader/linux-enable-usb-net-boot.config"
BR2_LINUX_KERNEL_DTS_SUPPORT=y
BR2_LINUX_KERNEL_INTREE_DTS_NAME="st/stm32mp135f-dk-ebook_reader"
BR2_LINUX_KERNEL_CUSTOM_DTS_DIR="$(BR2_EXTERNAL_ST_PATH)/board/ebook_reader/linux-dts"
BR2_LINUX_KERNEL_INSTALL_TARGET=y
BR2_LINUX_KERNEL_NEEDS_HOST_OPENSSL=y

##############################################
#                  Optee OS                  #
##############################################
BR2_PACKAGE_OPTEE_CLIENT=y
BR2_TARGET_OPTEE_OS=y
BR2_TARGET_OPTEE_OS_CUSTOM_TARBALL=y
BR2_TARGET_OPTEE_OS_CUSTOM_TARBALL_LOCATION="$(call github,STMicroelectronics,optee_os)4.0.0-stm32mp-r2.tar.gz"
BR2_TARGET_OPTEE_OS_NEEDS_DTC=y
BR2_TARGET_OPTEE_OS_NEEDS_PYTHON_CRYPTOGRAPHY=y
BR2_TARGET_OPTEE_OS_PLATFORM="stm32mp1"
BR2_TARGET_OPTEE_OS_PLATFORM_FLAVOR="135F_DK"
BR2_TARGET_OPTEE_OS_ADDITIONAL_VARIABLES="CFG_WITH_TUI=n"

##############################################
#                  TF-A                      #
##############################################
BR2_TARGET_ARM_TRUSTED_FIRMWARE=y
BR2_TARGET_ARM_TRUSTED_FIRMWARE_CUSTOM_TARBALL=y
BR2_TARGET_ARM_TRUSTED_FIRMWARE_CUSTOM_TARBALL_LOCATION="$(call github,STMicroelectronics,arm-trusted-firmware)v2.10-stm32mp-r2.tar.gz"
BR2_TARGET_ARM_TRUSTED_FIRMWARE_PLATFORM="stm32mp1"
BR2_TARGET_ARM_TRUSTED_FIRMWARE_FIP=y
BR2_TARGET_ARM_TRUSTED_FIRMWARE_BL32_OPTEE=y
BR2_TARGET_ARM_TRUSTED_FIRMWARE_UBOOT_AS_BL33=y
BR2_TARGET_ARM_TRUSTED_FIRMWARE_UBOOT_BL33_IMAGE="u-boot-nodtb.bin"
BR2_TARGET_ARM_TRUSTED_FIRMWARE_ADDITIONAL_VARIABLES="STM32MP_SDMMC=1 AARCH32_SP=optee DTB_FILE_NAME=stm32mp135f-dk.dtb BL33_CFG=$(BINARIES_DIR)/u-boot.dtb OPENSSL_DIR=$(BR2_HOST_DIR)"
BR2_TARGET_ARM_TRUSTED_FIRMWARE_IMAGES="*.stm32 fip.bin"
BR2_TARGET_ARM_TRUSTED_FIRMWARE_NEEDS_DTC=y

##############################################
#                  U-boot                    #
##############################################
BR2_TARGET_UBOOT=y
BR2_TARGET_UBOOT_BUILD_SYSTEM_KCONFIG=y
BR2_TARGET_UBOOT_CUSTOM_TARBALL=y
BR2_TARGET_UBOOT_CUSTOM_TARBALL_LOCATION="$(call github,STMicroelectronics,u-boot)v2023.10-stm32mp-r2.tar.gz"
BR2_TARGET_UBOOT_BOARD_DEFCONFIG="stm32mp13"
BR2_TARGET_UBOOT_NEEDS_PYLIBFDT=y
BR2_TARGET_UBOOT_NEEDS_OPENSSL=y
# BR2_TARGET_UBOOT_FORMAT_BIN is not set
BR2_TARGET_UBOOT_FORMAT_CUSTOM=y
BR2_TARGET_UBOOT_FORMAT_CUSTOM_NAME="u-boot-nodtb.bin u-boot.dtb"
BR2_TARGET_UBOOT_DEFAULT_ENV_FILE="$(BR2_EXTERNAL_ST_PATH)/board/ebook_reader/uboot.env"
BR2_TARGET_UBOOT_CONFIG_FRAGMENT_FILES="$(BR2_EXTERNAL_ST_PATH)/board/ebook_reader/uboot-enable-usb-net-boot.config"
BR2_TARGET_UBOOT_CUSTOM_DTS_PATH="$(BR2_EXTERNAL_ST_PATH)/board/ebook_reader/uboot-dts/*"
BR2_TARGET_UBOOT_CUSTOM_MAKEOPTS="dtb-y=stm32mp135f-dk-ebook_reader.dtb DEVICE_TREE=stm32mp135f-dk-ebook_reader"

##############################################
#                  Packages                  #
##############################################
BR2_PACKAGE_HTOP=y
BR2_PACKAGE_OPENSSH=y
BR2_PACKAGE_OPENSSH_SERVER=y
BR2_PACKAGE_OPENSSH_CLIENT=n
```

## package/ebook_reader/Config.in
```kconfig
config BR2_PACKAGE_EBOOK_READER
	bool "ebook_reader"
	help
          Ebook reader application.
	depends on BR2_PACKAGE_IT8951_EPAPER
	depends on BR2_PACKAGE_LVGL
```

## package/it8951_epaper/Config.in
```kconfig
config BR2_PACKAGE_IT8951_EPAPER
        bool "it8951_epaper"
        help
          Driver to IT8951 epaper screen.
```

## package/stm32wrapper4dbg/Config.in.host
```kconfig
config BR2_PACKAGE_HOST_STM32WRAPPER4DBG
        bool "host stm32wrapper4dbg"
        help
          Allow setting GDB breakpoints before the tf-a.
	  Requires bootstrapping `.stm32` images.

          https://github.com/STMicroelectronics/stm32wrapper4dbg
	  
```
