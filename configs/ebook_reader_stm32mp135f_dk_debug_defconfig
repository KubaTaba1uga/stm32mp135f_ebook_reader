## configs/ebook_reader_stm32mp135f_dk_debug_defconfig
```kconfig
##############################################
#                  Buildroot                 #
##############################################
BR2_arm=y
BR2_cortex_a7=y
BR2_GLOBAL_PATCH_DIR="$(BR2_EXTERNAL_EBK_READER_PATH)/board/stm32mp135f_dk/patches/"
BR2_CCACHE=y


##############################################
#                  Toolchain                 #
##############################################
BR2_TOOLCHAIN_EXTERNAL=y
BR2_TOOLCHAIN_EXTERNAL_BOOTLIN=y
BR2_TOOLCHAIN_EXTERNAL_BOOTLIN_ARMV7_EABIHF_GLIBC_STABLE=y


##############################################
#                  TF-A                      #
##############################################
BR2_TARGET_ARM_TRUSTED_FIRMWARE=y
BR2_TARGET_ARM_TRUSTED_FIRMWARE_CUSTOM_GIT=y
BR2_TARGET_ARM_TRUSTED_FIRMWARE_CUSTOM_REPO_URL="https://github.com/STMicroelectronics/arm-trusted-firmware.git"
BR2_TARGET_ARM_TRUSTED_FIRMWARE_CUSTOM_REPO_VERSION="v2.10-stm32mp-r2"
BR2_TARGET_ARM_TRUSTED_FIRMWARE_PLATFORM="stm32mp1"
BR2_TARGET_ARM_TRUSTED_FIRMWARE_FIP=y
BR2_TARGET_ARM_TRUSTED_FIRMWARE_BL32_OPTEE=y
BR2_TARGET_ARM_TRUSTED_FIRMWARE_UBOOT_AS_BL33=y
BR2_TARGET_ARM_TRUSTED_FIRMWARE_UBOOT_BL33_IMAGE="u-boot-nodtb.bin"
BR2_TARGET_ARM_TRUSTED_FIRMWARE_ADDITIONAL_VARIABLES="STM32MP_SDMMC=1 AARCH32_SP=optee DTB_FILE_NAME=stm32mp135f-dk-ebook-reader.dtb BL33_CFG=$(BINARIES_DIR)/u-boot.dtb OPENSSL_DIR=$(BR2_HOST_DIR) STM32MP_USB_PROGRAMMER=1 DEBUG=1"  # Enable debug: DEBUG=1 LOG_LEVEL=50 STM32MP_EARLY_CONSOLE=1
BR2_TARGET_ARM_TRUSTED_FIRMWARE_DEBUG=y
BR2_TARGET_ARM_TRUSTED_FIRMWARE_IMAGES="*.stm32 fip.bin"
BR2_TARGET_ARM_TRUSTED_FIRMWARE_NEEDS_DTC=y
BR2_TARGET_ARM_TRUSTED_FIRMWARE_CUSTOM_DTS_PATH="$(BR2_EXTERNAL_EBK_READER_PATH)/board/stm32mp135f_dk/tf-a/stm32mp13*dt*"


##############################################
#                  Optee OS                  #
##############################################
BR2_TARGET_OPTEE_OS=y
BR2_TARGET_OPTEE_OS_CUSTOM_GIT=y
BR2_TARGET_OPTEE_OS_CUSTOM_REPO_URL="https://github.com/STMicroelectronics/optee_os.git"
BR2_TARGET_OPTEE_OS_CUSTOM_REPO_VERSION="4.0.0-stm32mp-r2"
BR2_TARGET_OPTEE_OS_NEEDS_DTC=y
BR2_TARGET_OPTEE_OS_NEEDS_PYTHON_CRYPTOGRAPHY=y
BR2_TARGET_OPTEE_OS_PLATFORM="stm32mp1"
BR2_TARGET_OPTEE_OS_PLATFORM_FLAVOR="135F_DK"
BR2_TARGET_OPTEE_OS_CUSTOM_DTS_PATH="$(BR2_EXTERNAL_EBK_READER_PATH)/board/stm32mp135f_dk/optee-os/stm32mp13*dt*"
BR2_TARGET_OPTEE_OS_ADDITIONAL_VARIABLES="CFG_EMBED_DTB_SOURCE_FILE=stm32mp135f-dk-ebook-reader.dts CFG_STM32MP13=y CFG_WITH_TUI=n CFG_DRAM_SIZE=0x20000000 CFG_DT=y CFG_EMBED_DTB=y DEBUG=1" # Enable debug: CFG_TEE_CORE_LOG_LEVEL=3 DEBUG=1


##############################################
#                  U-boot                    #
##############################################
BR2_TARGET_UBOOT=y
BR2_TARGET_UBOOT_BUILD_SYSTEM_KCONFIG=y
BR2_TARGET_UBOOT_CUSTOM_GIT=y
BR2_TARGET_UBOOT_CUSTOM_REPO_URL="https://github.com/STMicroelectronics/u-boot.git"
BR2_TARGET_UBOOT_CUSTOM_REPO_VERSION="v2023.10-stm32mp-r2"
BR2_TARGET_UBOOT_BOARD_DEFCONFIG="stm32mp13"
BR2_TARGET_UBOOT_NEEDS_PYLIBFDT=y
BR2_TARGET_UBOOT_NEEDS_OPENSSL=y
# BR2_TARGET_UBOOT_FORMAT_BIN is not set
BR2_TARGET_UBOOT_FORMAT_CUSTOM=y
BR2_TARGET_UBOOT_FORMAT_CUSTOM_NAME="u-boot-nodtb.bin u-boot.dtb"
BR2_TARGET_UBOOT_CONFIG_FRAGMENT_FILES="$(BR2_EXTERNAL_EBK_READER_PATH)/board/stm32mp135f_dk/u-boot/default.config $(BR2_EXTERNAL_EBK_READER_PATH)/board/stm32mp135f_dk/u-boot/debug.config $(BR2_EXTERNAL_EBK_READER_PATH)/board/stm32mp135f_dk/u-boot/enable_usb_net.config"
BR2_TARGET_UBOOT_CUSTOM_DTS_PATH="$(BR2_EXTERNAL_EBK_READER_PATH)/board/stm32mp135f_dk/u-boot/*"
BR2_TARGET_UBOOT_CUSTOM_MAKEOPTS="dtb-y=stm32mp135f-dk-ebook-reader.dtb DEVICE_TREE=stm32mp135f-dk-ebook-reader"
BR2_TARGET_UBOOT_RUN_POST_RSYNC_HOOK_SCRIPT="$(BR2_EXTERNAL_EBK_READER_PATH)/board/stm32mp135f_dk/u-boot/uboot-post-rsync.sh"


##############################################
#                  Linux                     #
##############################################
BR2_LINUX_KERNEL=y
BR2_LINUX_KERNEL_CUSTOM_GIT=y
BR2_LINUX_KERNEL_CUSTOM_REPO_URL="https://github.com/STMicroelectronics/linux.git"
BR2_LINUX_KERNEL_CUSTOM_REPO_VERSION="v6.6-stm32mp-r2"
BR2_LINUX_KERNEL_DEFCONFIG="multi_v7"
BR2_LINUX_KERNEL_CONFIG_FRAGMENT_FILES="$(LINUX_DIR)/arch/arm/configs/fragment-01-multiv7_cleanup.config $(LINUX_DIR)/arch/arm/configs/fragment-02-multiv7_addons.config $(BR2_EXTERNAL_EBK_READER_PATH)/board/stm32mp135f_dk/linux/default.config $(BR2_EXTERNAL_EBK_READER_PATH)/board/stm32mp135f_dk/linux/debug.config $(BR2_EXTERNAL_EBK_READER_PATH)/board/stm32mp135f_dk/linux/enable_usb_net.config"
BR2_LINUX_KERNEL_DTS_SUPPORT=y
BR2_LINUX_KERNEL_INTREE_DTS_NAME="st/stm32mp135f-dk-ebook-reader"
BR2_LINUX_KERNEL_CUSTOM_DTS_PATH="$(BR2_EXTERNAL_EBK_READER_PATH)/board/stm32mp135f_dk/linux/st"
BR2_LINUX_KERNEL_INSTALL_TARGET=y
BR2_LINUX_KERNEL_NEEDS_HOST_OPENSSL=y


##############################################
#                  Rootfs                    #
##############################################
BR2_ROOTFS_POST_IMAGE_SCRIPT="support/scripts/genimage.sh"
BR2_ROOTFS_POST_SCRIPT_ARGS="-c $(BR2_EXTERNAL_EBK_READER_PATH)/board/stm32mp135f_dk/dev/genimage.cfg"
BR2_TARGET_ROOTFS_EXT2=y
BR2_TARGET_ROOTFS_EXT2_2=y
BR2_TARGET_ROOTFS_EXT2_LABEL="rootfs"
BR2_TARGET_ROOTFS_EXT2_SIZE="120M"
BR2_TARGET_GENERIC_HOSTNAME="ebook_reader"
BR2_ROOTFS_DEVICE_CREATION_DYNAMIC_MDEV=y
BR2_TARGET_ROOTFS_TAR=y
BR2_ROOTFS_POST_BUILD_SCRIPT="$(BR2_EXTERNAL_EBK_READER_PATH)/board/stm32mp135f_dk/dev/rootfs_postbuild_openocd.sh"
BR2_PACKAGE_HOST_STM32WRAPPER4DBG=y
BR2_PACKAGE_HOST_BMAP_TOOLS=y
BR2_PACKAGE_HOST_GENIMAGE=y
BR2_PACKAGE_HTOP=y
BR2_PACKAGE_OPENSSH=y
BR2_PACKAGE_OPENSSH_SERVER=y
BR2_PACKAGE_OPENSSH_CLIENT=n
BR2_PACKAGE_UEMACS=y
BR2_PACKAGE_LIBGPIOD=y
BR2_PACKAGE_LIBGPIOD_TOOLS=y
BR2_PACKAGE_SPIDEV_TEST=y
BR2_PACKAGE_GDB=y
BR2_PACKAGE_GDB_DEBUGGER=y
BR2_PACKAGE_GDB_TUI=y
BR2_PACKAGE_GDB_SERVER=y
BR2_PACKAGE_CAIRO=y
BR2_PACKAGE_CAIRO_PNG=y
BR2_PACKAGE_CAIRO_TEE=y
BR2_PACKAGE_LIBGLIB2=y
BR2_PACKAGE_POPPLER=y
BR2_PACKAGE_OPENJPEG=y
BR2_PACKAGE_LIBPNG=y
BR2_PACKAGE_TIFF=y
BR2_PACKAGE_STRACE=y
BR2_PACKAGE_POPPLER_UTILS=y
BR2_PACKAGE_SQLITE=y
BR2_PACKAGE_LINUX_TOOLS_PERF=y
BR2_PACKAGE_UFTRACE=y


##############################################
#                  Debug                    #
##############################################
BR2_PACKAGE_OVERRIDE_FILE="$(BR2_EXTERNAL_EBK_READER_PATH)/board/stm32mp135f_dk/dev/local.mk"
```
